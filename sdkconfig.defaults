## sdkconfig.defaults
```kconfig
# ESP32-S3-N16R8 COB-LED Controller Default Configuration

# Target
CONFIG_IDF_TARGET="esp32s3"

# Flash size
CONFIG_ESPTOOLPY_FLASHSIZE_16MB=y
CONFIG_ESPTOOLPY_FLASHSIZE="16MB"

# PSRAM
CONFIG_SPIRAM=y
CONFIG_SPIRAM_MODE_OCT=y
CONFIG_SPIRAM_SPEED_80M=y

# Partition table
CONFIG_PARTITION_TABLE_CUSTOM=y
CONFIG_PARTITION_TABLE_CUSTOM_FILENAME="partitions.csv"
CONFIG_PARTITION_TABLE_FILENAME="partitions.csv"

# CPU Frequency
CONFIG_ESP_DEFAULT_CPU_FREQ_MHZ_240=y

# FreeRTOS
CONFIG_FREERTOS_UNICORE=n
CONFIG_FREERTOS_HZ=1000

# Log level
CONFIG_LOG_DEFAULT_LEVEL_INFO=y

# LVGL
CONFIG_LV_CONF_SKIP=n
CONFIG_LV_USE_PERF_MONITOR=n
CONFIG_LV_USE_MEM_MONITOR=n

# WiFi
CONFIG_ESP_WIFI_STATIC_RX_BUFFER_NUM=16
CONFIG_ESP_WIFI_DYNAMIC_RX_BUFFER_NUM=64

# ESP-NOW
CONFIG_ESP_WIFI_ESPNOW_MAX_ENCRYPT_NUM=2

# NimBLE
CONFIG_BT_ENABLED=y
CONFIG_BT_NIMBLE_ENABLED=y

# HTTP Server
CONFIG_HTTPD_MAX_REQ_HDR_LEN=1024
CONFIG_HTTPD_MAX_URI_LEN=512
CONFIG_HTTPD_WS_SUPPORT=y

# OTA (HTTP allowed for dev)
CONFIG_ESP_HTTPS_OTA_ALLOW_HTTP=y

# SNTP
CONFIG_LWIP_SNTP_UPDATE_DELAY=3600000

# Power Management
CONFIG_PM_ENABLE=y
CONFIG_FREERTOS_USE_TICKLESS_IDLE=y

# Interrupt Watchdog (disabled - MCPWM init needs long critical section)
# CONFIG_ESP_INT_WDT is not set

# Task Watchdog (5s timeout, no idle task check)
CONFIG_ESP_TASK_WDT=y
CONFIG_ESP_TASK_WDT_TIMEOUT_S=5
CONFIG_ESP_TASK_WDT_CHECK_IDLE_TASK_CPU0=n
CONFIG_ESP_TASK_WDT_CHECK_IDLE_TASK_CPU1=n

# Console (UART0 uses default console)
```
