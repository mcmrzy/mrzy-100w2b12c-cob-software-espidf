/**
 * @file cct_table.h
 * @brief CCT (色温) PWM 查找表
 *
 * 提供 2700K ~ 6500K 范围内色温到暖白/冷白 PWM 占空比的映射。
 * 38 个步进，每步 100K，从纯暖 (2700K) 到纯冷 (6500K)。
 */

#ifndef CCT_TABLE_H
#define CCT_TABLE_H

#include <stdint.h>

#ifdef __cplusplus
extern "C" {
#endif

/* ======================== 表格参数 ======================== */

#define CCT_TABLE_STEPS     38      /* 查找表步数 */
#define PWM_DEAD_ZONE       30      /* PWM 死区，防止 LED 闪烁的最小值 */

/* ======================== CCT -> PWM 查找表 ======================== */

/*
 * CCT_PWM_TABLE[i][0] = 暖白 (Warm White) PWM 值
 * CCT_PWM_TABLE[i][1] = 冷白 (Yellow/Cool White) PWM 值
 *
 * 索引 0  = 2700K (纯暖)
 * 索引 37 = 6500K (纯冷)
 *
 * 亮度归一化到 PWM_MAX (1023)，实际输出时乘以亮度系数。
 * 值为 0 表示该通道关闭。
 */
static const uint16_t CCT_PWM_TABLE[CCT_TABLE_STEPS][2] = {
    /*  idx  CCT    Warm    Cool   */
    /*   0  2700K */ {1023,     0},   /* 纯暖白 */
    /*   1  2800K */ { 982,    41},
    /*   2  2900K */ { 941,    82},
    /*   3  3000K */ { 900,   123},
    /*   4  3100K */ { 859,   164},
    /*   5  3200K */ { 818,   205},
    /*   6  3300K */ { 777,   246},
    /*   7  3400K */ { 736,   287},
    /*   8  3500K */ { 695,   328},
    /*   9  3600K */ { 654,   369},
    /*  10  3700K */ { 613,   410},
    /*  11  3800K */ { 572,   451},
    /*  12  3900K */ { 531,   492},
    /*  13  4000K */ { 490,   533},
    /*  14  4100K */ { 449,   574},
    /*  15  4200K */ { 408,   615},
    /*  16  4300K */ { 367,   656},
    /*  17  4400K */ { 326,   697},
    /*  18  4500K */ { 285,   738},
    /*  19  4600K */ { 244,   779},
    /*  20  4700K */ { 203,   820},
    /*  21  4800K */ { 162,   861},
    /*  22  4900K */ { 121,   902},
    /*  23  5000K */ {  80,   943},
    /*  24  5100K */ {  39,   984},
    /*  25  5200K */ {   0,  1023},   /* 纯冷白起始 */
    /*  26  5300K */ {   0,  1023},
    /*  27  5400K */ {   0,  1023},
    /*  28  5500K */ {   0,  1023},
    /*  29  5600K */ {   0,  1023},
    /*  30  5700K */ {   0,  1023},
    /*  31  5800K */ {   0,  1023},
    /*  32  5900K */ {   0,  1023},
    /*  33  6000K */ {   0,  1023},
    /*  34  6100K */ {   0,  1023},
    /*  35  6200K */ {   0,  1023},
    /*  36  6300K */ {   0,  1023},
    /*  37  6500K */ {   0,  1023},   /* 纯冷白 */
};

/* ======================== CCT 值表 ======================== */

/*
 * 每个索引对应的色温值 (K)
 */
static const uint16_t CCT_VALUE_TABLE[CCT_TABLE_STEPS] = {
    2700, 2800, 2900, 3000, 3100,
    3200, 3300, 3400, 3500, 3600,
    3700, 3800, 3900, 4000, 4100,
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    6200, 6300, 6500,
};

/* ======================== 内联转换函数 ======================== */

/**
 * @brief 将色温值转换为查找表索引
 * @param cct 色温值 (2700 ~ 6500 K)
 * @return 查找表索引 (0 ~ 37)，超出范围时钳位
 */
static inline uint8_t cct_to_index(uint16_t cct)
{
    if (cct <= 2700) return 0;
    if (cct >= 6500) return CCT_TABLE_STEPS - 1;

    /* 线性映射: index = (cct - 2700) / 100 */
    uint8_t idx = (uint8_t)((cct - 2700) / 100);

    /* 钳位到有效范围 */
    if (idx >= CCT_TABLE_STEPS) {
        idx = CCT_TABLE_STEPS - 1;
    }

    return idx;
}

/**
 * @brief 将查找表索引转换为色温值
 * @param idx 查找表索引 (0 ~ 37)
 * @return 色温值 (K)，超出范围时返回默认值 4600K
 */
static inline uint16_t index_to_cct(uint8_t idx)
{
    if (idx >= CCT_TABLE_STEPS) {
        return 4600;  /* CCT_DEFAULT */
    }
    return CCT_VALUE_TABLE[idx];
}

#ifdef __cplusplus
}
#endif

#endif /* CCT_TABLE_H */
